/*
 * Copyright (c) 2025 Nordic Semiconductor ASA
 *
 * SPDX-License-Identifier: Apache-2.0
 */

<<<<<<<< HEAD:boards/nordic/nrf9280pdk/nrf9280pdk_nrf9280_cpuppr_xip_0_2_0.overlay
#include "nrf9280pdk_nrf9280-pinctrl_0_2_0.dtsi"
========
#include "../usb_audio.overlay"
>>>>>>>> 433893e54b9ca7e70d6f158690839b56913d5dce:tests/bluetooth/shell/boards/nrf5340_audio_dk_nrf5340_cpuapp.overlay
