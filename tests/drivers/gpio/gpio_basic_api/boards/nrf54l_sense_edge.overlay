/*
 * Copyright (c) 2025 Nordic Semiconductor ASA
 *
 * SPDX-License-Identifier: Apache-2.0
 */

<<<<<<<< HEAD:boards/nordic/nrf9280pdk/nrf9280pdk_nrf9280_cpurad_0_2_0.overlay
#include "nrf9280pdk_nrf9280-pinctrl_0_2_0.dtsi"
========
&gpio1 {
	sense-edge-mask = <0xC00>;
};
>>>>>>>> 433893e54b9ca7e70d6f158690839b56913d5dce:tests/drivers/gpio/gpio_basic_api/boards/nrf54l_sense_edge.overlay
