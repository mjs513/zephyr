## tests/drivers/i2c/i2c_api/boards/ek_ra4c1.conf
```kconfig
# Copyright (c) 2025 Renesas Electronics Corporation
# SPDX-License-Identifier: Apache-2.0

<<<<<<<< HEAD:boards/shields/rtk0eg0019b01002bj/boards/rssk_ra2l1.conf
CONFIG_INPUT_RENESAS_RA_DEVICE_VCC=5000
========
CONFIG_SENSOR_GY271_HMC=y
>>>>>>>> 433893e54b9ca7e70d6f158690839b56913d5dce:tests/drivers/i2c/i2c_api/boards/ek_ra4c1.conf
```
